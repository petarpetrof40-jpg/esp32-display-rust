## sdkconfig.defaults
```kconfig
# ── UART / Console ──────────────────────────────────────────────────────────
# Serial monitor baud rate (must match the terminal / esptool setting)
CONFIG_ESP_CONSOLE_UART_BAUDRATE=115200

# ── Task stack sizes ─────────────────────────────────────────────────────────
# Main task needs more stack for graphics / SPI operations
CONFIG_ESP_MAIN_TASK_STACK_SIZE=8192
CONFIG_PTHREAD_TASK_STACK_SIZE_DEFAULT=8192
CONFIG_ESP_SYSTEM_EVENT_TASK_STACK_SIZE=4096

# ── FreeRTOS tick rate ────────────────────────────────────────────────────────
# 1 kHz tick gives 1 ms resolution for FreeRtos::delay_ms()
CONFIG_FREERTOS_HZ=1000

# ── Watchdog ─────────────────────────────────────────────────────────────────
# Disable the task watchdog so the main loop can block on touch polling
# without triggering a reboot.  Re-enable and add wdt_reset() calls in
# production firmware.
CONFIG_ESP_TASK_WDT_EN=n
```
